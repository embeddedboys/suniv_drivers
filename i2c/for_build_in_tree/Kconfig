## i2c/for_build_in_tree/Kconfig
```kconfig
# SPDX-License-Identifier: GPL-2.0-only
#
# Sensor device configuration
#

menu "I2C Hardware Bus support"
	depends on HAS_IOMEM

config I2C_SUNIV
	tristate "Allwinner suniv I2C Controller"
	depends on PLAT_ORION || ARCH_SUNXI || COMPILE_TEST
	help
	  If you say yes to this option, support will be included for the
	  built-in I2C interface on the Allwinner suniv SoCs I2C controllers.

	  This driver can also be built as a module.  If so, the module
	  will be called i2c-suniv.

endmenu
```
